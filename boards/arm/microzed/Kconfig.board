## boards/arm/microzed/Kconfig.board
```kconfig
# Microzed board configuration

# Copyright (c) 2022 Henrik Brix Andersen <henrik@brixandersen.dk>
# SPDX-License-Identifier: Apache-2.0

config BOARD_MICROZED 
	bool "Microzed board"
	depends on SOC_XILINX_XC7Z010
```

## boards/arm/microzed/Kconfig.defconfig
```kconfig
# Avnet Microzed board 

# Copyright (c) 2022 Henrik Brix Andersen <henrik@brixandersen.dk>
# SPDX-License-Identifier: Apache-2.0

if BOARD_MICROZED

config BOARD
	default "microzed"

config SYS_CLOCK_TICKS_PER_SEC
	default 1000

if GDBSTUB

config GDBSTUB_BUF_SZ
	default 512

endif # GDBSTUB

endif # BOARD_MICROZED
```
